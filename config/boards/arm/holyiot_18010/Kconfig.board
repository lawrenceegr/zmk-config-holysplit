## config/boards/arm/holyiot_18010/Kconfig.board
```kconfig
# Copyright (c) 2024
# SPDX-License-Identifier: MIT

config BOARD_HOLYIOT_18010
	bool "Holyiot 18010 nRF52840 Module"
	depends on SOC_NRF52840_QIAA
```

## config/boards/arm/holyiot_18010/Kconfig.defconfig
```kconfig
# Copyright (c) 2024
# SPDX-License-Identifier: MIT

if BOARD_HOLYIOT_18010

config BOARD
	default "holyiot_18010"

config ZMK_KEYBOARD_NAME
	default "Holyiot 18010"

if USB_DEVICE_STACK

config USB_NRFX
	default y

config USB_DEVICE_REMOTE_WAKEUP
	default n

endif # USB_DEVICE_STACK

config BT_CTLR
	default BT

config ZMK_BLE
	default y

config ZMK_USB
	default y

endif # BOARD_HOLYIOT_18010
```

## config/boards/shields/holysplit/Kconfig.defconfig
```kconfig
if SHIELD_HOLYSPLIT_LEFT

config ZMK_KEYBOARD_NAME
    default "HolySplit Left"

config ZMK_SPLIT_ROLE_CENTRAL
    default y

endif

if SHIELD_HOLYSPLIT_LEFT || SHIELD_HOLYSPLIT_RIGHT

config ZMK_SPLIT
    default y

endif
```

## config/boards/shields/holysplit/Kconfig.shield
```kconfig
# Copyright (c) 2024
# SPDX-License-Identifier: MIT

config SHIELD_HOLYSPLIT_LEFT
	def_bool $(shields_list_contains,holysplit_left)

config SHIELD_HOLYSPLIT_RIGHT
	def_bool $(shields_list_contains,holysplit_right)
```
